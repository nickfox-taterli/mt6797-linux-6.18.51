// SPDX-License: GPL-2.0-only
/*
 * X20-96 production DT, USB device-mode variant (NCM management link).
 *
 * Same common base as the default host entry (mt6797-x20-96-codec.dts):
 * mt6797-x20-96.dtsi already carries the USB device base (GPIO86 hogged
 * low so the TC7USB40 mux routes the SoC data pair to the Micro-USB
 * receptacle, mtu3 registered as a fixed high-speed peripheral, no xHCI
 * child and no host VBUS regulator), so this entry intentionally adds
 * nothing. The SoC has a single USB controller and the mux is exclusive:
 * host and device cannot be active at the same time (verified on the
 * board). Host boots by default; switch by deploying the bundle built
 * from this file and back with the host bundle.
 */
/dts-v1/;

#include "mt6797-x20-96.dtsi"
