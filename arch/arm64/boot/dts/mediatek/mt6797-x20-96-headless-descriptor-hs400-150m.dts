// SPDX-License-Identifier: GPL-2.0-only
/* eMMC-only descriptor-DMA probe at the next MT6797 HS400 clock step. */
/dts-v1/;

#include "mt6797-x20-96-headless.dts"

&mmc0 {
	mediatek,disable-async-dma;
	mediatek,descriptor-dma;
	mediatek,descriptor-max-req-size = <4194304>;
	mediatek,disable-hsq;
	max-frequency = <150000000>;
};
