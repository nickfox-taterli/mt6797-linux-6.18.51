// SPDX-License-Identifier: GPL-2.0-only
/* eMMC-only HS400 isolation probe: keep the 192 MHz clock, bypass DMA. */
/dts-v1/;

#include "mt6797-x20-96-headless.dts"

&mmc0 {
	mediatek,disable-hsq;
	max-frequency = <200000000>;
};
