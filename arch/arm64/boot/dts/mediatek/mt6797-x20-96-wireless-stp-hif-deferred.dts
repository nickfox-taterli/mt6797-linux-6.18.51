// SPDX-License-Identifier: GPL-2.0-only
/* W2 image: canonical eMMC HS400 plus a deferred STP diagnostic client. */
/dts-v1/;

#include "mt6797-x20-96-wireless-stp-hif.dts"

&stp_diag {
	mediatek,defer-registration;
};
