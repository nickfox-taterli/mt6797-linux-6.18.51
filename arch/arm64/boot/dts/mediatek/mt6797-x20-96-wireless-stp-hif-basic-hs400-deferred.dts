// SPDX-License-Identifier: GPL-2.0-only
/* W2 image: defer STP diagnostic registration until the real rootfs is mounted. */
/dts-v1/;

#include "mt6797-x20-96-wireless-stp-hif-basic-hs400.dts"

&stp_diag {
	mediatek,defer-registration;
};
