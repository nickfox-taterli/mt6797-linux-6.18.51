// SPDX-License-Identifier: GPL-2.0-only
/* W2 image: WLAN HIF with the known-bootable Basic-DMA HS400 eMMC path. */
/dts-v1/;

#include "mt6797-x20-96-wireless-stp.dts"

&mmc0 {
	mediatek,disable-hsq;
};

&wifi_hif {
	status = "okay";
};
