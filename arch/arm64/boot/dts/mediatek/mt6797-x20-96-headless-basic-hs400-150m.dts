// SPDX-License-Identifier: GPL-2.0-only
/*
 * eMMC-only isolation probe: retain HS400 and Basic DMA, but lower the
 * requested MSDC0 clock from the 200 MHz canonical request to 150 MHz.
 * There are no ConSys, BTIF, STP, or WLAN nodes in this device tree.
 */
/dts-v1/;

#include "mt6797-x20-96-headless.dts"

&mmc0 {
	mediatek,disable-hsq;
	max-frequency = <150000000>;
};
