## Documentation/devicetree/bindings/clock/mediatek,mt6797-mfgcfg.yaml
```yaml
# SPDX-License-Identifier: (GPL-2.0-only OR BSD-2-Clause)
%YAML 1.2
---
$id: http://devicetree.org/schemas/clock/mediatek,mt6797-mfgcfg.yaml#
$schema: http://devicetree.org/meta-schemas/core.yaml#

title: MediaTek MT6797 GPU clock gate

maintainers:
  - Matthias Brugger <matthias.bgg@gmail.com>

properties:
  compatible:
    const: mediatek,mt6797-mfgcfg
  reg:
    maxItems: 1
  '#clock-cells':
    const: 1

required:
  - compatible
  - reg
  - '#clock-cells'

additionalProperties: false
```

## Documentation/devicetree/bindings/display/bridge/mediatek,mt8193.yaml
```yaml
# SPDX-License-Identifier: GPL-2.0-only
%YAML 1.2
---
$id: http://devicetree.org/schemas/display/bridge/mediatek,mt8193.yaml#
$schema: http://devicetree.org/meta-schemas/core.yaml#

title: MediaTek MT8193 external HDMI transmitter

maintainers:
  - Matthias Brugger <matthias.bgg@gmail.com>

description: |
  The MT8193 is an external multibridge with an HDMI transmitter. This binding
  describes control, power, DDC and the parallel video input. The MT6797 X20 board wires
  an 8-bit CCIR656 input to DPI1.

properties:
  compatible:
    const: mediatek,mt8193
  reg:
    maxItems: 1
  reset-gpios:
    maxItems: 1
  enable-gpios:
    maxItems: 1
    description: Enables the board HDMI 5 V output.
  vmipi-supply: true
  vrf12-supply: true
  vibr-supply: true
  vldo28-supply: true
  port:
    $ref: /schemas/graph.yaml#/properties/port
    description: CCIR656 video input from the SoC DPI controller.

required:
  - compatible
  - reg
  - reset-gpios
  - enable-gpios
  - vmipi-supply
  - vrf12-supply
  - vibr-supply
  - vldo28-supply

additionalProperties: false
```

## Documentation/devicetree/bindings/media/mediatek,mt6797-vdec.yaml
```yaml
# SPDX-License-Identifier: (GPL-2.0-only OR BSD-2-Clause)
%YAML 1.2
---
$id: http://devicetree.org/schemas/media/mediatek,mt6797-vdec.yaml#
$schema: http://devicetree.org/meta-schemas/core.yaml#

title: MediaTek MT6797 H.264, HEVC and VP9 stateless decoder

# This workspace has no public maintainer address assigned.
maintainers: []

description: |
  V4L2 stateless memory-to-memory decoder with Media Requests. The kernel
  programs the engine, owns reconstructed pictures and codec contexts,
  and uses the associated SMI larb and translated M4U ports for DMA.

properties:
  compatible:
    const: mediatek,mt6797-vdec
  reg:
    maxItems: 1
  interrupts:
    maxItems: 1
  clocks:
    minItems: 3
    maxItems: 3
  power-domains:
    maxItems: 1
  mediatek,larb:
    $ref: /schemas/types.yaml#/definitions/phandle
    description: SMI larb serving the decoder.
  iommus:
    minItems: 10
    maxItems: 10

required:
  - compatible
  - reg
  - interrupts
  - clocks
  - power-domains
  - mediatek,larb
  - iommus

additionalProperties: false
...
```

## Documentation/devicetree/bindings/media/mediatek,mt6797-venc.yaml
```yaml
# SPDX-License-Identifier: (GPL-2.0-only OR BSD-2-Clause)
%YAML 1.2
---
$id: http://devicetree.org/schemas/media/mediatek,mt6797-venc.yaml#
$schema: http://devicetree.org/meta-schemas/core.yaml#

title: MediaTek MT6797 AVC and HEVC encoder

# This workspace has no public maintainer address assigned.
maintainers: []

description: |
  Firmware-free V4L2 memory-to-memory encoder. The kernel programs the
  engine and its generated event controller, owns reconstructed pictures,
  and uses the associated SMI larb and translated M4U ports for DMA.

properties:
  compatible:
    const: mediatek,mt6797-venc
  reg:
    maxItems: 1
  interrupts:
    maxItems: 1
  clocks:
    minItems: 3
    maxItems: 3
  power-domains:
    maxItems: 1
  mediatek,larb:
    $ref: /schemas/types.yaml#/definitions/phandle
    description: SMI larb serving the encoder.
  iommus:
    minItems: 11
    maxItems: 11

required:
  - compatible
  - reg
  - interrupts
  - clocks
  - power-domains
  - mediatek,larb
  - iommus

additionalProperties: false
...
```

## Documentation/devicetree/bindings/net/bluetooth/mediatek,mt6797-bluetooth.yaml
```yaml
# SPDX-License-Identifier: (GPL-2.0-only OR BSD-2-Clause)
%YAML 1.2
---
$id: http://devicetree.org/schemas/net/bluetooth/mediatek,mt6797-bluetooth.yaml#
$schema: http://devicetree.org/meta-schemas/core.yaml#

title: MediaTek MT6797 integrated Bluetooth over BTIF and STP

maintainers:
  - TaterLi <admin@taterli.com>

description: |
  The integrated MT6797/MT6631 controller exchanges H4 bytes over the BT task
  of the shared BTIF/STP/WMT transport. Its WMT provider owns firmware, clocks,
  reset and shared connectivity rails; the Bluetooth consumer owns the BT
  radio function and standard HCI. It is not a serial UART or an SDIO device.

properties:
  compatible:
    const: mediatek,mt6797-bluetooth

  mediatek,wmt:
    $ref: /schemas/types.yaml#/definitions/phandle
    description: Shared MT6797 WMT provider.

required:
  - compatible
  - mediatek,wmt

additionalProperties: false

examples:
  - |
    bluetooth {
        compatible = "mediatek,mt6797-bluetooth";
        mediatek,wmt = <&wmt>;
    };
```

## Documentation/devicetree/bindings/power/reset/mediatek,mt6797-fastboot.txt
```
MT6797 Fastboot reboot marker
============================

This board bring-up device writes MT6351 RTC_PDN1[13] before the system
restart handler resets the SoC. It does not perform the reset itself.

Required properties:
- compatible: "mediatek,mt6797-fastboot"
- mediatek,pwrap: phandle to the MT6797 PMIC wrapper providing the MT6351
  register map.

Use a separate device node. The MT6351 PMIC node is owned by the regulator
driver; two platform drivers cannot bind that node simultaneously.

Example:

fastboot-reboot {
	compatible = "mediatek,mt6797-fastboot";
	mediatek,pwrap = <&pwrap>;
};
```

## Documentation/devicetree/bindings/power/reset/mediatek,mt6797-fastboot.yaml
```yaml
# SPDX-License-Identifier: (GPL-2.0-only OR BSD-2-Clause)
%YAML 1.2
---
$schema: http://devicetree.org/meta-schemas/core.yaml#

$id: http://devicetree.org/schemas/power/reset/mediatek,mt6797-fastboot.yaml#

title: MediaTek MT6797 Fastboot reboot marker

description: |
  This board bring-up device writes MT6351 RTC_PDN1[13] before the system
  restart handler resets the SoC. It does not perform the reset itself.
  It must be a separate device node: the MT6351 PMIC node is owned by the
  regulator driver and two platform drivers cannot bind one node.

maintainers:
  - X20-96 board port

properties:
  compatible:
    const: mediatek,mt6797-fastboot

  mediatek,pwrap:
    $ref: /schemas/types.yaml#/definitions/phandle
    description: MT6797 PMIC wrapper providing the MT6351 register map.

required:
  - compatible
  - mediatek,pwrap

additionalProperties: false

examples:
  - |
    fastboot-reboot {
        compatible = "mediatek,mt6797-fastboot";
        mediatek,pwrap = <&pwrap>;
    };
...
```

## Documentation/devicetree/bindings/regulator/dlg,da9211.yaml
```yaml
# SPDX-License-Identifier: (GPL-2.0-only OR BSD-2-Clause)
%YAML 1.2
---
$id: http://devicetree.org/schemas/regulator/dlg,da9211.yaml#
$schema: http://devicetree.org/meta-schemas/core.yaml#

title: Dialog Semiconductor DA9211/DA9212/DA9213/DA9223/DA9214/DA9224/DA9215/DA9225 buck regulators

maintainers:
  - Support Opensource <support.opensource@diasemi.com>

description: |
  Multi-phase buck converters controlled over I2C. Every package provides
  BUCKA; BUCKB is described for the dual-rail parts (and boards may leave
  it unwired, like mt8173-evb wiring both rails on a DA9211). The
  regulator subnode contract, including the initial/allowed mode values
  from include/dt-bindings/regulator/dlg,da9211-regulator.h, follows
  regulator.yaml. The optional enable GPIO is consumed per rail from the
  BUCK subnode, matching da9211_parse_regulators_dt().

properties:
  compatible:
    enum:
      - dlg,da9211
      - dlg,da9212
      - dlg,da9213
      - dlg,da9223
      - dlg,da9214
      - dlg,da9224
      - dlg,da9215
      - dlg,da9225

  reg:
    maxItems: 1

  interrupts:
    maxItems: 1
    description: IRQ line of the converter; unused on boards that only drive
      the rails over I2C.

  regulators:
    type: object
    additionalProperties: false

    properties:
      BUCKA:
        type: object
        $ref: /schemas/regulator/regulator.yaml#
        unevaluatedProperties: false
        properties:
          enable-gpios:
            maxItems: 1
            description: Optional GPIO controlling this rail's enable input.

      BUCKB:
        type: object
        $ref: /schemas/regulator/regulator.yaml#
        unevaluatedProperties: false
        properties:
          enable-gpios:
            maxItems: 1
            description: Optional GPIO controlling this rail's enable input.

required:
  - compatible
  - reg
  - regulators

additionalProperties: false

examples:
  - |
    #include <dt-bindings/regulator/dlg,da9211-regulator.h>

    i2c {
        #address-cells = <1>;
        #size-cells = <0>;

        da9214@68 {
            compatible = "dlg,da9214";
            reg = <0x68>;

            regulators {
                BUCKA {
                    regulator-name = "vproc1";
                    regulator-min-microvolt = <780000>;
                    regulator-max-microvolt = <1200000>;
                    regulator-min-microamp = <3000000>;
                    regulator-max-microamp = <6000000>;
                    regulator-initial-mode = <DA9211_BUCK_MODE_SYNC>;
                    regulator-allowed-modes = <DA9211_BUCK_MODE_SYNC
                                                DA9211_BUCK_MODE_AUTO>;
                    regulator-always-on;
                };

                BUCKB {
                    regulator-name = "vproc2";
                    regulator-min-microvolt = <800000>;
                    regulator-max-microvolt = <1200000>;
                    regulator-min-microamp = <3000000>;
                    regulator-max-microamp = <6000000>;
                    regulator-initial-mode = <DA9211_BUCK_MODE_SYNC>;
                    regulator-allowed-modes = <DA9211_BUCK_MODE_SYNC
                                                DA9211_BUCK_MODE_AUTO>;
                    regulator-always-on;
                };
            };
        };
    };
...
```

## Documentation/devicetree/bindings/reserved-memory/mediatek,consys-reserve-memory.yaml
```yaml
# SPDX-License-Identifier: (GPL-2.0-only OR BSD-2-Clause)
%YAML 1.2
---
$schema: http://devicetree.org/meta-schemas/core.yaml#

$id: http://devicetree.org/schemas/reserved-memory/mediatek,consys-reserve-memory.yaml#

title: MediaTek ConSys reserved EMI memory

description: |
  Dynamically allocated, 2 MiB-aligned no-map EMI window reserved for the
  MT6797 connectivity subsystem firmware and the shared ConSys
  diagnostics. Consumed through memory-region by the ConSys power owner.

maintainers:
  - X20-96 board port

allOf:
  - $ref: reserved-memory.yaml

properties:
  compatible:
    const: mediatek,consys-reserve-memory

required:
  - compatible

unevaluatedProperties: false

examples:
  - |
    reserved-memory {
        #address-cells = <2>;
        #size-cells = <2>;
        ranges;

        consys-emi-memory {
            compatible = "mediatek,consys-reserve-memory";
            no-map;
            size = <0 0x200000>;
            alignment = <0 0x200000>;
            alloc-ranges = <0 0x40000000 0 0x80000000>;
        };
    };
...
```

## Documentation/devicetree/bindings/rtc/mediatek,mt6351-rtc.yaml
```yaml
# SPDX-License-Identifier: (GPL-2.0-only OR BSD-2-Clause)
%YAML 1.2
---
$id: http://devicetree.org/schemas/rtc/mediatek,mt6351-rtc.yaml#
$schema: http://devicetree.org/meta-schemas/core.yaml#

title: MediaTek MT6351 PMIC real-time clock through PMIC wrapper

maintainers:
  - MediaTek Linux mailing list <linux-mediatek@lists.infradead.org>

description: |
  The MT6351 RTC registers are accessed through the MT6797 PMIC wrapper.
  This binding describes the timekeeping function when no PMIC interrupt
  controller is available. Alarm and wakeup are not provided in this mode.

properties:
  compatible:
    const: mediatek,mt6351-rtc

  mediatek,pwrap:
    $ref: /schemas/types.yaml#/definitions/phandle
    description: PMIC wrapper providing the MT6351 register map.

required:
  - compatible
  - mediatek,pwrap

additionalProperties: false

examples:
  - |
    pwrap: syscon {
        compatible = "syscon";
    };

    rtc {
        compatible = "mediatek,mt6351-rtc";
        mediatek,pwrap = <&pwrap>;
    };
...
```

## Documentation/devicetree/bindings/soc/mediatek/mediatek,mt6351.yaml
```yaml
# SPDX-License-Identifier: (GPL-2.0-only OR BSD-2-Clause)
%YAML 1.2
---
$schema: http://devicetree.org/meta-schemas/core.yaml#

$id: http://devicetree.org/schemas/soc/mediatek/mediatek,mt6351.yaml#

title: MediaTek MT6351 Power Management IC

description: |
  MT6351 PMIC exposed as a child of the MT6797 PMIC wrapper. The
  regulators sub-node carries the mediatek,mt6351-regulator compatible and
  one child per MT6351 regulator (ldo_*/buck_* node names, matching the
  mt6351-regulator driver names).

maintainers:
  - X20-96 board port

properties:
  compatible:
    const: mediatek,mt6351

  regulators:
    type: object

    properties:
      compatible:
        const: mediatek,mt6351-regulator

    patternProperties:
      "^(ldo_|buck_)[a-z0-9_-]+$":
        type: object
        $ref: /schemas/regulator/regulator.yaml#
        unevaluatedProperties: false

    additionalProperties: false

    required:
      - compatible

required:
  - compatible

additionalProperties: false

examples:
  - |
    pmic {
        compatible = "mediatek,mt6351";
        regulators {
            compatible = "mediatek,mt6351-regulator";
            ldo_vmch {
                regulator-name = "vmch";
                regulator-min-microvolt = <3300000>;
                regulator-max-microvolt = <3300000>;
            };
        };
    };
...
```

## Documentation/devicetree/bindings/soc/mediatek/mediatek,mt6797-btif.yaml
```yaml
# SPDX-License-Identifier: (GPL-2.0-only OR BSD-2-Clause)
%YAML 1.2
---
$id: http://devicetree.org/schemas/soc/mediatek/mediatek,mt6797-btif.yaml#
$title: MediaTek MT6797 Bluetooth serial interface (BTIF)

maintainers:
  - X20-96 board port

description: |
  Dedicated MediaTek Bluetooth host interface with its TX/RX DMA
  channels. Consumers (STP diagnostics, HCI bridges) reference this node
  through the mediatek stack bindings; the optional mediatek,use-dma
  property is described in mtk-sd-style per-consumer bindings.

properties:
  compatible:
    const: mediatek,mt6797-btif

  reg:
    minItems: 3
    maxItems: 3

  reg-names:
    items:
      - const: btif
      - const: tx-dma
      - const: rx-dma

  interrupts:
    minItems: 3
    maxItems: 3

  clocks:
    minItems: 2
    maxItems: 2

  clock-names:
    items:
      - const: btif
      - const: dma

  mediatek,use-dma:
    type: boolean
    description: Use the BTIF DMA channels for large transfers.

required:
  - compatible
  - reg
  - reg-names
  - interrupts
  - clocks
  - clock-names

additionalProperties: false

examples:
  - |
    btif@1100c000 {
        compatible = "mediatek,mt6797-btif";
        reg = <0 0x1100c000 0 0x1000>,
              <0 0x11000a00 0 0x80>,
              <0 0x11000a80 0 0x80>;
        reg-names = "btif", "tx-dma", "rx-dma";
        interrupts = <0 130 4>, <0 116 4>, <0 117 4>;
        clocks = <&infracfg 0>, <&infracfg 1>;
        clock-names = "btif", "dma";
    };
...
```
