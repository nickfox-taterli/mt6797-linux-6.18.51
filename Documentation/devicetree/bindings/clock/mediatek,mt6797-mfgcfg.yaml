## Documentation/devicetree/bindings/soc/mediatek/mediatek,mt6797-wlan-hif.yaml
```yaml
# SPDX-License-Identifier: (GPL-2.0-only OR BSD-2-Clause)
%YAML 1.2
---
$id: http://devicetree.org/schemas/soc/mediatek/mediatek,mt6797-wlan-hif.yaml#
$title: MediaTek MT6797 WLAN AHB host interface (HIF)

maintainers:
  - X20-96 board port

description: |
  AHB sdioLike host interface window of the MT6797 WLAN subsystem with a
  shared AP_DMA view. Optional on boards that reach the WLAN firmware
  exclusively through the WMT/STP path.

properties:
  compatible:
    const: mediatek,mt6797-wlan-hif

  reg:
    minItems: 2
    maxItems: 2

  reg-names:
    items:
      - const: hif
      - const: dma

  interrupts:
    maxItems: 1

  clocks:
    maxItems: 1

  clock-names:
    const: wifi-dma

  mediatek,use-dma:
    type: boolean
    description: Use the shared DMA view for HIF transfers.

required:
  - compatible
  - reg
  - reg-names

additionalProperties: false

examples:
  - |
    wifi@180f0000 {
        compatible = "mediatek,mt6797-wlan-hif";
        reg = <0 0x180f0000 0 0x1100>,
              <0 0x11000080 0 0x80>;
        reg-names = "hif", "dma";
        interrupts = <0 283 4>;
        clocks = <&infracfg 0>;
        clock-names = "wifi-dma";
    };
...
```

## Documentation/devicetree/bindings/soc/mediatek/mediatek,mt6797-wlan.yaml
```yaml
# SPDX-License-Identifier: (GPL-2.0-only OR BSD-2-Clause)
%YAML 1.2
---
$id: http://devicetree.org/schemas/soc/mediatek/mediatek,mt6797-wlan.yaml#
$schema: http://devicetree.org/meta-schemas/core.yaml#

title: MediaTek MT6797 WLAN device (W2 firmware over WMT)

maintainers:
  - X20 Bring-up <x20@localhost>

description: |
  WLAN function device driven through the WMT firmware transport.
  The nvram firmware name identifies the per-board calibration blob
  loaded from the rootfs/lib-firmware set.

properties:
  compatible:
    const: mediatek,mt6797-wlan

  mediatek,wmt:
    description: Phandle to the WMT firmware transport coordinator.
    $ref: /schemas/types.yaml#/definitions/phandle

  mediatek,nvram-firmware:
    description: Firmware filename containing the board WLAN calibration data.
    $ref: /schemas/types.yaml#/definitions/string

required:
  - compatible
  - mediatek,wmt

additionalProperties: false

examples:
  - |
    wlan {
        compatible = "mediatek,mt6797-wlan";
        mediatek,wmt = <&wmt>;
        mediatek,nvram-firmware = "mediatek/mt6797-x20-wifi-nvram.bin";
    };
...
```

## Documentation/devicetree/bindings/soc/mediatek/mediatek,mt6797-wmt.yaml
```yaml
# SPDX-License-Identifier: (GPL-2.0-only OR BSD-2-Clause)
%YAML 1.2
---
$id: http://devicetree.org/schemas/soc/mediatek/mediatek,mt6797-wmt.yaml#
$schema: http://devicetree.org/meta-schemas/core.yaml#

title: MediaTek MT6797 WMT firmware transport coordinator

maintainers:
  - X20 Bring-up <x20@localhost>

description: |
  Firmware-side WMT protocol endpoint coordinating the MT6797 radio
  (WiFi/BT/GPS) over ConSys and BTIF. The node carries no register
  window; it references the ConSys power owner and the BTIF transport,
  and the radio configuration from the board WMT_SOC.cfg.

properties:
  compatible:
    const: mediatek,mt6797-wmt

  interrupts:
    maxItems: 1

  consys:
    $ref: /schemas/types.yaml#/definitions/phandle

  btif:
    $ref: /schemas/types.yaml#/definitions/phandle

  mediatek,antenna-mode:
    description: Antenna configuration value passed to the WMT firmware.
    $ref: /schemas/types.yaml#/definitions/uint8

  mediatek,fm-transport:
    description: FM transport selection passed to the WMT firmware.
    $ref: /schemas/types.yaml#/definitions/uint8

required:
  - compatible
  - interrupts
  - consys
  - btif

additionalProperties: false

examples:
  - |
    wmt {
        compatible = "mediatek,mt6797-wmt";
        interrupts = <0 284 4>;
        consys = <&consys>;
        btif = <&btif>;
        mediatek,antenna-mode = /bits/ 8 <1>;
        mediatek,fm-transport = /bits/ 8 <2>;
    };
...
```

## Documentation/devicetree/bindings/spi/st,stm32l452re-test.yaml
```yaml
# SPDX-License-Identifier: (GPL-2.0-only OR BSD-2-Clause)
%YAML 1.2
---
$id: http://devicetree.org/schemas/spi/st,stm32l452re-test.yaml#
$schema: http://devicetree.org/meta-schemas/core.yaml#

title: STM32L452RE laboratory SPI target

maintainers:
  - X20 Board Maintainers <x20@localhost>

description: |
  STM32L452RE running the X20 test-peer firmware. A host utility arms a
  full-duplex sequence/length/CRC transfer through an independent UART.
  The SPI endpoint is accessed through an explicit spidev driver override.

allOf:
  - $ref: spi-peripheral-props.yaml#

properties:
  compatible:
    const: st,stm32l452re-test
  reg:
    maxItems: 1
  spi-max-frequency:
    maximum: 12000000

required:
  - compatible
  - reg
  - spi-max-frequency

unevaluatedProperties: false
```
