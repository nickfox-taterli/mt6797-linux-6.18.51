## Documentation/devicetree/bindings/soc/mediatek/mediatek,mt6797-consys.yaml
```yaml
# SPDX-License-Identifier: (GPL-2.0-only OR BSD-2-Clause)
%YAML 1.2
---
$id: http://devicetree.org/schemas/soc/mediatek/mediatek,mt6797-consys.yaml#
$title: MediaTek MT6797 connectivity subsystem (ConSys) power owner

maintainers:
  - X20-96 board port

description: |
  Owner of the MT6797 connectivity subsystem power sequence: CONN_MCU
  configuration window plus the AP-side RGU, TOPCKGEN and SPM views used
  for reset and clock/release control. Supplies are the MT6631 radio
  rails. Firmware DMA memory comes from a reserved ConSys EMI region
  referenced through memory-region (see
  mediatek,consys-reserve-memory.yaml).

properties:
  compatible:
    const: mediatek,mt6797-consys

  reg:
    minItems: 4
    maxItems: 4

  vcn18-supply: true
  vcn28-supply: true
  vcn33-bt-supply: true
  vcn33-wifi-supply: true

  memory-region:
    maxItems: 1

required:
  - compatible
  - reg

additionalProperties: false

examples:
  - |
    consys@18070000 {
        compatible = "mediatek,mt6797-consys";
        reg = <0 0x18070000 0 0x200>,
              <0 0x10007000 0 0x100>,
              <0 0x10000000 0 0x2000>,
              <0 0x10006000 0 0x1000>;
    };
...
```

## Documentation/devicetree/bindings/soc/mediatek/mediatek,mt6797-cpufreq.yaml
```yaml
# SPDX-License-Identifier: (GPL-2.0-only OR BSD-2-Clause)
%YAML 1.2
---
$id: http://devicetree.org/schemas/soc/mediatek/mediatek,mt6797-cpufreq.yaml#
$schema: http://devicetree.org/meta-schemas/core.yaml#

title: MediaTek MT6797 CPU frequency and voltage coordination block

maintainers:
  - X20 Bring-up <x20@localhost>

description: |
  Board-level coordination window for the MT6797 cpufreq driver: mixed
  MCU/top clock registers, the HW semaphore and the INFRACFG bus. The
  operating points themselves are supplied per-CPU-cluster via
  operating-points-v2 tables referenced by the CPU nodes. A read-only
  clock provider exposes LL, L, BIG and CCI as indices 0 through 3; rate
  changes remain coordinated with the CPU and CCI voltage votes.

properties:
  compatible:
    const: mediatek,mt6797-cpufreq

  "#clock-cells":
    const: 1

  reg:
    items:
      - description: MCUSYS mixed clock registers
      - description: TOPCKGEN registers shared with the clock controller
      - description: DVFS hardware semaphore
      - description: INFRACFG SRAM LDO registers

  reg-names:
    items:
      - const: mcumixed
      - const: topckgen
      - const: semaphore
      - const: infracfg

required:
  - compatible
  - reg
  - reg-names

additionalProperties: false

examples:
  - |
    cpufreq@1001a000 {
        compatible = "mediatek,mt6797-cpufreq";
        reg = <0x1001a000 0x1000>,
              <0x10000000 0x1000>,
              <0x11015000 0x1000>,
              <0x10001000 0x1000>;
        reg-names = "mcumixed", "topckgen", "semaphore", "infracfg";
        #clock-cells = <1>;
    };
...
```

## Documentation/devicetree/bindings/soc/mediatek/mediatek,mt6797-dcm.yaml
```yaml
# SPDX-License-Identifier: (GPL-2.0-only OR BSD-2-Clause)
%YAML 1.2
---
$id: http://devicetree.org/schemas/soc/mediatek/mediatek,mt6797-dcm.yaml#
$schema: http://devicetree.org/meta-schemas/core.yaml#

title: MediaTek MT6797 bus and CPU dynamic clock management

maintainers:
  - TaterLi <admin@taterli.com>

description: |
  Controls the infrastructure and peripheral bus dynamic clock gating fields
  in the shared INFRACFG syscon and the static MCUSYS fields via firmware.
  ARMCORE DCM shares MCUMIXED access with the CPUFreq supplier, including
  its software lock, hardware semaphore and register bridge workarounds.
  MEM/DFS_MEM fields use their latched APB configuration sequences. CPU sync
  DCM is managed by CPUFreq; DRAM PLLs and DDR PHY are not configured here.

properties:
  compatible:
    const: mediatek,mt6797-dcm
  mediatek,infracfg:
    $ref: /schemas/types.yaml#/definitions/phandle
    description: INFRACFG always-on syscon
  mediatek,cpufreq:
    $ref: /schemas/types.yaml#/definitions/phandle
    description: MT6797 CPUFreq device owning the shared MCUMIXED access
  clocks:
    maxItems: 1
  clock-names:
    const: axi

required:
  - compatible
  - mediatek,infracfg
  - mediatek,cpufreq
  - clocks
  - clock-names

additionalProperties: false

examples:
  - |
    dcm {
        compatible = "mediatek,mt6797-dcm";
        mediatek,infracfg = <&infracfg>;
        mediatek,cpufreq = <&cpufreq>;
        clocks = <&topckgen 1>;
        clock-names = "axi";
    };
```

## Documentation/devicetree/bindings/soc/mediatek/mediatek,mt6797-gpt-wakeup.yaml
```yaml
# SPDX-License-Identifier: (GPL-2.0-only OR BSD-2-Clause)
%YAML 1.2
---
$id: http://devicetree.org/schemas/soc/mediatek/mediatek,mt6797-gpt-wakeup.yaml#
$schema: http://devicetree.org/meta-schemas/core.yaml#

title: MediaTek MT6797 APXGPT4 suspend wake timer

maintainers:
  - X20 Bring-up <x20@localhost>

description: |
  GPT4 is the BSP low power wake timer. It uses the 32kHz source while the
  architectural timer tick is stopped. GPT2 supplies the nonstop suspend
  clocksource used to account for sleep time. Bootloader interrupt masks
  are cleared when Linux takes ownership of the APXGPT page.

properties:
  compatible:
    const: mediatek,mt6797-gpt-wakeup
  reg:
    maxItems: 1
  interrupts:
    maxItems: 1
  clocks:
    maxItems: 1
  wakeup-source: true

required:
  - compatible
  - reg
  - interrupts
  - clocks
  - wakeup-source

additionalProperties: false
```

## Documentation/devicetree/bindings/soc/mediatek/mediatek,mt6797-scpsys.yaml
```yaml
# SPDX-License-Identifier: (GPL-2.0-only OR BSD-2-Clause)
%YAML 1.2
---
$id: http://devicetree.org/schemas/soc/mediatek/mediatek,mt6797-scpsys.yaml#
$schema: http://devicetree.org/meta-schemas/core.yaml#

title: MediaTek MT6797 System Control Processor System (SCPSYS)

maintainers:
  - X20 Bring-up <x20@localhost>

description: |
  The System Control Processor System holds the System Power Manager (SPM)
  which controls the MT6797 MTCMOS power domains, bus protection and
  the GPU SRAM rail sequencing. This binding covers the MT6797 power
  controller; the generic power-domain consumer contract is defined by
  power/power-domain.yaml and the domain indices live in
  include/dt-bindings/power/mt6797-power.h.

  All non-SCM bus-protection and GPU SRAM rail registers live inside the
  INFRACFG register space, so every domain access goes through the single
  infracfg syscon regmap referenced below.

$ref: /schemas/power/power-domain.yaml#

patternProperties:
  "^(vdec|venc|isp|mm|audio|mfg_async|mfg|mfg_core[0-3]|mjc)-supply$":
    description: Power supply for the named power domain.

properties:
  compatible:
    const: mediatek,mt6797-scpsys

  reg:
    maxItems: 1

  infracfg:
    $ref: /schemas/types.yaml#/definitions/phandle
    description: Phandle to the INFRACFG syscon controller.

  clocks:
    minItems: 3
    maxItems: 4
    description: |
      Clocks which must be enabled before the matching power domains can be
      enabled. The mfg52m asynchronous clock is only required when the
      MFG_ASYNC domain is in use.

  clock-names:
    oneOf:
      - items:
          - const: mfg
          - const: mm
          - const: vdec
      - items:
          - const: mfg
          - const: mm
          - const: vdec
          - const: mfg52m

required:
  - compatible
  - reg
  - infracfg
  - clocks
  - clock-names
  - "#power-domain-cells"

unevaluatedProperties: false

examples:
  - |
    #include <dt-bindings/clock/mt6797-clk.h>

    scpsys: power-controller@10006000 {
        compatible = "mediatek,mt6797-scpsys";
        reg = <0 0x10006000 0 0x1000>;
        infracfg = <&infrasys>;
        #power-domain-cells = <1>;
        clocks = <&topckgen CLK_TOP_MUX_MFG>,
                 <&topckgen CLK_TOP_MUX_MM>,
                 <&topckgen CLK_TOP_MUX_VDEC>,
                 <&infrasys CLK_INFRA_MFG_VCG>;
        clock-names = "mfg", "mm", "vdec", "mfg52m";
        mfg_async-supply = <&vgpu>;
    };
...
```

## Documentation/devicetree/bindings/soc/mediatek/mediatek,mt6797-spm-suspend.yaml
```yaml
# SPDX-License-Identifier: (GPL-2.0-only OR BSD-2-Clause)
%YAML 1.2
---
$id: http://devicetree.org/schemas/soc/mediatek/mediatek,mt6797-spm-suspend.yaml#
$schema: http://devicetree.org/meta-schemas/core.yaml#

title: MediaTek MT6797 SPM system suspend

maintainers:
  - X20 Bring-up <x20@localhost>

description: |
  System sleep shares the SPM register page, PMIC wrapper DVFS commands,
  DDR PHY and clocks with the VCORE/DRAM DVFS controller. The VCORE supplier
  owns those resources and relinquishes the PCM before system sleep uses
  them. The X20 TF-A sleep capability ABI v1 is required for CPU0 warm resume.

properties:
  compatible:
    const: mediatek,mt6797-spm-suspend

  reg:
    maxItems: 1
    description: CIRQ retention register page for SPI72 through SPI290

  clocks:
    maxItems: 1

  clock-names:
    const: cirq

  mediatek,gic:
    $ref: /schemas/types.yaml#/definitions/phandle
    description: GIC distributor whose interrupt state is cloned and replayed

  mediatek,sysirq:
    $ref: /schemas/types.yaml#/definitions/phandle
    description: System interrupt polarity controller with secure register access

  mediatek,vcorefs:
    $ref: /schemas/types.yaml#/definitions/phandle
    description: VCORE controller providing resources and exclusive PCM ownership

  interrupts:
    maxItems: 1

  wakeup-source: true

required:
  - compatible
  - reg
  - clocks
  - clock-names
  - mediatek,vcorefs
  - mediatek,gic
  - mediatek,sysirq
  - interrupts
  - wakeup-source

additionalProperties: false
```

## Documentation/devicetree/bindings/soc/mediatek/mediatek,mt6797-stp-diag.yaml
```yaml
# SPDX-License-Identifier: (GPL-2.0-only OR BSD-2-Clause)
%YAML 1.2
---
$id: http://devicetree.org/schemas/soc/mediatek/mediatek,mt6797-stp-diag.yaml#
$schema: http://devicetree.org/meta-schemas/core.yaml#

title: MediaTek MT6797 STP diagnostics transport

maintainers:
  - X20 Bring-up <x20@localhost>

description: |
  Bounded STP protocol diagnostics endpoint sharing the ConSys/BTIF
  transport with production WiFi/BT. Registration can be deferred so the
  diagnostic device never races the radio bring-up.

properties:
  compatible:
    const: mediatek,mt6797-stp-diag

  consys:
    $ref: /schemas/types.yaml#/definitions/phandle

  mediatek,antenna-mode:
    description: Antenna configuration value passed to the WMT firmware.
    $ref: /schemas/types.yaml#/definitions/uint8

  mediatek,fm-transport:
    description: FM transport selection passed to the WMT firmware.
    $ref: /schemas/types.yaml#/definitions/uint8

  mediatek,defer-registration:
    type: boolean
    description: Register only after the production radio consumers are up.

required:
  - compatible
  - consys

additionalProperties: false

examples:
  - |
    stp-diag {
        compatible = "mediatek,mt6797-stp-diag";
        consys = <&consys>;
        mediatek,antenna-mode = /bits/ 8 <1>;
        mediatek,fm-transport = /bits/ 8 <2>;
        mediatek,defer-registration;
    };
...
```

## Documentation/devicetree/bindings/soc/mediatek/mediatek,mt6797-vcodec-lab.yaml
```yaml
# SPDX-License-Identifier: (GPL-2.0-only OR BSD-2-Clause)
%YAML 1.2
---
$id: http://devicetree.org/schemas/soc/mediatek/mediatek,mt6797-vcodec-lab.yaml#
$title: MediaTek MT6797 codec lab diagnostic blocks
$schema: http://devicetree.org/dtschema/draft-01/schema#

maintainers:
  - X20-96 board port

description: |
  Register-level access points for the deployed mt6797-codec-lab
  diagnostic module: direct VENC and VDEC engine windows sharing the
  SMI/M4U media path. Production userspace goes through the standard
  V4L2 devices; these nodes are the diagnostic ABI.

properties:
  compatible:
    enum:
      - mediatek,mt6797-venc-lab
      - mediatek,mt6797-vdec-lab

  reg:
    maxItems: 1

  interrupts:
    maxItems: 1

  clocks:
    minItems: 2
    maxItems: 3

  power-domains:
    maxItems: 1

  mediatek,larb:
    $ref: /schemas/types.yaml#/definitions/phandle
    description: Associated SMI larb for the engine's DMA ports.

  iommus:
    minItems: 2
    maxItems: 11
    description: M4U port IDs owned by the engine.

required:
  - compatible
  - reg
  - interrupts
  - clocks
  - power-domains
  - mediatek,larb
  - iommus

additionalProperties: false

examples:
  - |
    video-encoder@17002000 {
        compatible = "mediatek,mt6797-venc-lab";
        // Declare the cell format: the wrapper defaults to 1/1 and would
        // otherwise parse this reg as two regions.
        #address-cells = <2>;
        #size-cells = <2>;
        reg = <0 0x17002000 0 0x1000>;
        interrupts = <0 235 8>;
        clocks = <&mmsys 0>, <&vencsys 1>, <&vencsys 2>;
        power-domains = <&scpsys 6>;
        mediatek,larb = <&smi_larb3>;
        iommus = <&m4u 96>, <&m4u 97>;
    };
...
```

## Documentation/devicetree/bindings/soc/mediatek/mediatek,mt6797-vcorefs.yaml
```yaml
# SPDX-License-Identifier: (GPL-2.0-only OR BSD-2-Clause)
%YAML 1.2
---
$id: http://devicetree.org/schemas/soc/mediatek/mediatek,mt6797-vcorefs.yaml#
$schema: http://devicetree.org/meta-schemas/core.yaml#

title: MediaTek MT6797 SPM VCORE and DRAM DVFS

maintainers:
  - X20 Bring-up <x20@localhost>

description: |
  SPM vcorefs for the X20-96 LPDDR3-1600 single-rank memory configuration.
  The power controller owns the shared SPM register page. The DVFS command
  bank is separate from the PMIC wrapper driver's WACS registers. A reserved
  page supplies firmware dummy reads without accessing Linux allocations.

properties:
  compatible:
    const: mediatek,mt6797-vcorefs

  reg:
    items:
      - description: DRAMC always-on registers
      - description: DDR PHY registers
      - description: PMIC wrapper DVFS command bank
      - description: Chip hardware revision
      - description: CPU SPM semaphore and inactive-firmware guard
      - description: BIG SPM semaphore and inactive-firmware guard

  reg-names:
    items:
      - const: dramc
      - const: ddrphy
      - const: pwrap-dvfs
      - const: chip-version
      - const: cpu-spm
      - const: big-spm

  mediatek,infracfg:
    $ref: /schemas/types.yaml#/definitions/phandle
    description: Infrastructure controller providing the SPM address mapping mode

  clocks:
    maxItems: 8

  clock-names:
    items:
      - const: spm
      - const: dvfs
      - const: ddrphy
      - const: dramc
      - const: dramc-b
      - const: axi
      - const: axi-high
      - const: axi-low

  mediatek,dcm:
    $ref: /schemas/types.yaml#/definitions/phandle
    description: DCM supplier serializing MEM/DFS_MEM latch transactions

  mediatek,spm:
    $ref: /schemas/types.yaml#/definitions/phandle
    description: Power controller containing the shared SPM register page

  memory-region:
    maxItems: 1
    description: Reserved dummy-read page in the board's single DRAM rank

  mediatek,pmic-wrapper:
    $ref: /schemas/types.yaml#/definitions/phandle
    description: PMIC wrapper providing the MT6351 regmap

required:
  - compatible
  - reg
  - reg-names
  - mediatek,spm
  - mediatek,infracfg
  - clocks
  - clock-names
  - mediatek,pmic-wrapper
  - memory-region
  - mediatek,dcm

additionalProperties: false
```
