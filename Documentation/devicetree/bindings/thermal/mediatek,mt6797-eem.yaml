## Documentation/devicetree/bindings/thermal/mediatek,mt6797-eem.yaml
```yaml
# SPDX-License-Identifier: (GPL-2.0-only OR BSD-2-Clause)
%YAML 1.2
---
$id: http://devicetree.org/schemas/thermal/mediatek,mt6797-eem.yaml#
$schema: http://devicetree.org/meta-schemas/core.yaml#

title: MediaTek MT6797 EEM detector with manual CPU voltage ownership

maintainers:
  - X20 Bring-up <x20@localhost>

description: |
  EEM shares the thermal register page and bank selector. This node describes
  the CPU and CCI detectors. INIT01 uses temporary stable 1V CPU supplies and
  restores the manual voltages. INIT02 and MON produce advisory measurements;
  they never install a voltage table or control the CPU voltage regulators.

properties:
  compatible:
    const: mediatek,mt6797-eem

  mediatek,thermal:
    $ref: /schemas/types.yaml#/definitions/phandle
    description: Thermal controller with the shared EEM registers and calibration

  mediatek,cpufreq:
    $ref: /schemas/types.yaml#/definitions/phandle
    description: CPUfreq provider serializing calibration with DVFS and hotplug

  nvmem-cells:
    maxItems: 1

  nvmem-cell-names:
    const: calibration-data

required:
  - compatible
  - mediatek,thermal
  - mediatek,cpufreq
  - nvmem-cells
  - nvmem-cell-names

additionalProperties: false
```

## Documentation/devicetree/bindings/thermal/mediatek,mt6797-otp.yaml
```yaml
# SPDX-License-Identifier: (GPL-2.0-only OR BSD-2-Clause)
%YAML 1.2
---
$id: http://devicetree.org/schemas/thermal/mediatek,mt6797-otp.yaml#
$schema: http://devicetree.org/meta-schemas/core.yaml#

title: MediaTek MT6797 hardware thermal PID

maintainers:
  - X20 Bring-up <x20@localhost>

description: |
  The BIG cluster PID receives thermal controller samples. Firmware mediates
  its register accesses. CPUfreq applies frequency caps using the existing
  manual voltage OPPs; autonomous iDVFS voltage control is not enabled.

properties:
  compatible:
    const: mediatek,mt6797-otp

  mediatek,thermal:
    $ref: /schemas/types.yaml#/definitions/phandle
    description: Thermal controller supplying the calibrated BIG sensor

required:
  - compatible
  - mediatek,thermal

additionalProperties: false
```

## drivers/media/platform/mediatek/Kconfig
```kconfig
# SPDX-License-Identifier: GPL-2.0-only

comment "Mediatek media platform drivers"

config VIDEO_MT6797_CODEC_LAB
	tristate "MT6797 BSP codec algorithm resource bridge"
	depends on ARCH_MEDIATEK && MTK_IOMMU && COMPAT
	help
	  Root-only bring-up bridge for the MT6797 BSP algorithm libraries.
	  Provides bounded DMA, M4U, clock, power and IRQ access per engine.

source "drivers/media/platform/mediatek/jpeg/Kconfig"
source "drivers/media/platform/mediatek/mdp/Kconfig"
source "drivers/media/platform/mediatek/vcodec/Kconfig"
source "drivers/media/platform/mediatek/vpu/Kconfig"
source "drivers/media/platform/mediatek/mdp3/Kconfig"
```

## drivers/net/wireless/mediatek/Kconfig
```kconfig
# SPDX-License-Identifier: GPL-2.0-only
config WLAN_VENDOR_MEDIATEK
	bool "MediaTek devices"
	default y
	help
	  If you have a wireless card belonging to this class, say Y.

	  Note that the answer to this question doesn't directly affect the
	  kernel: saying N will just cause the configurator to skip all the
	  questions about these cards. If you say Y, you will be asked for
	  your specific card in the following questions.

if WLAN_VENDOR_MEDIATEK

config MTK_MT6797_WLAN
	tristate "MT6797/MT6631 AHB WLAN"
	depends on OF && CFG80211 && MTK_MT6797_WMT && MTK_MT6797_WLAN_HIF
	select WIRELESS_EXT
	select WEXT_PRIV
	select NVMEM
	help
	  MT6797 WLAN using the BSP gen3 protocol core with mainline Linux and
	  shared ConSys lifecycle interfaces. Supports the existing STA/AP/P2P
	  protocol paths; board firmware and calibration data are required.
source "drivers/net/wireless/mediatek/mt7601u/Kconfig"
source "drivers/net/wireless/mediatek/mt76/Kconfig"
endif # WLAN_VENDOR_MEDIATEK
```

## drivers/soc/mediatek/Kconfig
```kconfig
# SPDX-License-Identifier: GPL-2.0-only
#
# MediaTek SoC drivers
#
menu "MediaTek SoC drivers"
	depends on ARCH_MEDIATEK || COMPILE_TEST

config MTK_CMDQ
	tristate "MediaTek CMDQ Support"
	depends on ARCH_MEDIATEK || COMPILE_TEST
	select MAILBOX
	select MTK_CMDQ_MBOX
	select MTK_INFRACFG
	help
	  Say yes here to add support for the MediaTek Command Queue (CMDQ)
	  driver. The CMDQ is used to help read/write registers with critical
	  time limitation, such as updating display configuration during the
	  vblank.

config MTK_DEVAPC
	tristate "Mediatek Device APC Support"
	help
	  Say yes here to enable support for Mediatek Device APC driver.
	  This driver is mainly used to handle the violation which catches
	  unexpected transaction.
	  The violation information is logged for further analysis or
	  countermeasures.

config MTK_DVFSRC
	tristate "MediaTek DVFSRC Support"
	depends on ARCH_MEDIATEK
	help
	  Say yes here to add support for the MediaTek Dynamic Voltage
	  and Frequency Scaling Resource Collector (DVFSRC): a HW
	  IP found on many MediaTek SoCs, which is responsible for
	  collecting DVFS requests from various SoC IPs, other than
	  software, and performing bandwidth scaling to provide the
	  best achievable performance-per-watt.

config MTK_INFRACFG
	bool "MediaTek INFRACFG Support"
	select REGMAP
	help
	  Say yes here to add support for the MediaTek INFRACFG controller. The
	  INFRACFG controller contains various infrastructure registers not
	  directly associated to any device.

config MTK_PMIC_WRAP
	tristate "MediaTek PMIC Wrapper Support"
	depends on RESET_CONTROLLER
	depends on OF
	select REGMAP
	help
	  Say yes here to add support for MediaTek PMIC Wrapper found
	  on different MediaTek SoCs. The PMIC wrapper is a proprietary
	  hardware to connect the PMIC.

config MTK_MT6797_DCM
	tristate "MediaTek MT6797 INFRA/PERI dynamic clock management"
	depends on ARCH_MEDIATEK && OF
	select MFD_SYSCON
	help
	  Apply the MT6797 BSP always-on infrastructure and peripheral bus
	  dynamic clock gating settings. CPU sync DCM is managed by cpufreq;
	  DRAM, DDR PHY and memory clock control are not modified here.

config MTK_REGULATOR_COUPLER
	bool "MediaTek SoC Regulator Coupler" if COMPILE_TEST
	default ARCH_MEDIATEK
	depends on REGULATOR

config MTK_MMSYS
	tristate "MediaTek MMSYS Support"
	default ARCH_MEDIATEK
	depends on HAS_IOMEM
	depends on MTK_CMDQ || MTK_CMDQ=n
	help
	  Say yes here to add support for the MediaTek Multimedia
	  Subsystem (MMSYS).

config MTK_SVS
	tristate "MediaTek Smart Voltage Scaling(SVS)"
	depends on NVMEM_MTK_EFUSE && NVMEM
	help
	  The Smart Voltage Scaling(SVS) engine is a piece of hardware
	  which has several controllers(banks) for calculating suitable
	  voltage to different power domains(CPU/GPU/CCI) according to
	  chip process corner, temperatures and other factors. Then DVFS
	  driver could apply SVS bank voltage to PMIC/Buck.

config MTK_SOCINFO
	tristate "MediaTek SoC Information"
	default y
	depends on NVMEM_MTK_EFUSE
	select SOC_BUS
	help
	  The MediaTek SoC Information (mtk-socinfo) driver provides
	  information about the SoC to the userspace including the
	  manufacturer name, marketing name and soc name.


config MTK_MT6797_CONSYS
	tristate "MT6797 ConSys power/bring-up driver"
	depends on ARCH_MEDIATEK || COMPILE_TEST
	help
	  Power-on/bring-up support for the MT6797 connectivity subsystem
	  (ConSys) that hosts the WLAN/BT/GPS baseband and drives the external
	  MT6631 radio.  Exposes a sysfs power switch and chip-ID readback for
	  board bring-up; protocol stacks are separate drivers.

config MTK_MT6797_BTIF
	tristate "MT6797 ConSys BTIF PIO transport"
	depends on ARCH_MEDIATEK || COMPILE_TEST
	depends on MTK_MT6797_CONSYS
	depends on COMMON_CLK
	help
	  PIO byte transport for the MT6797 ConSys BTIF block.  This is not a
	  serial console or a 16550 UART; an STP/WMT client must claim it before
	  the clock, FIFO and IRQ are enabled.

config MTK_MT6797_STP
	tristate "MT6797 ConSys STP wire codec"
	depends on ARCH_MEDIATEK || COMPILE_TEST
	depends on MTK_MT6797_BTIF
	help
	  Allocation-free STP header/CRC16 codec and streaming decoder for the
	  MT6797 ConSys transport.  It does not power the chip or claim BTIF;
	  WMT sequencing and retransmission are supplied by a separate client.

config MTK_MT6797_STP_SESSION
	tristate "MT6797 ConSys reliable STP/WMT session"
	depends on ARCH_MEDIATEK || COMPILE_TEST
	depends on MTK_MT6797_STP
	help
	  Reliable full-mode STP sequence/ACK/retry and WMT event matching on top
	  of the MT6797 BTIF transport.  It claims BTIF only when explicitly
	  started by a higher-level ConSys owner and does not power the chip.

config MTK_MT6797_WMT_INIT
	tristate "MT6797 WMT firmware initialization"
	depends on MTK_MT6797_CONSYS && MTK_MT6797_STP_SESSION
	select FW_LOADER
	help
	  Shared ROM version and ROMv3 patch/reset initialization for MT6797
	  connectivity clients. The caller owns ConSys power and the STP session.

config MTK_MT6797_STP_DIAG
	tristate "MT6797 bounded STP/WMT diagnostic client"
	depends on ARCH_MEDIATEK || COMPILE_TEST
	depends on MTK_MT6797_CONSYS
	depends on MTK_MT6797_STP_SESSION
	depends on MTK_MT6797_WLAN_HIF
	select MTK_MT6797_WMT_INIT
	help
	  Root-controlled diagnostic client for one bounded MT6797 STP/WMT
	  transaction.  It requires ConSys to be powered explicitly, reserves the
	  host parser while the transaction runs, and never exposes BTIF as a tty
	  or HCI device.

config MTK_MT6797_WMT
	tristate "MT6797 shared connectivity lifecycle"
	depends on OF && MTK_MT6797_CONSYS && MTK_MT6797_STP_SESSION
	select MTK_MT6797_WMT_INIT
	select SRCU
	help
	  Share the powered firmware and STP session between standard WLAN and
	  Bluetooth clients. Firmware starts with the first client and stops with
	  the last one; independent radio rails and callbacks are managed here.

config MTK_MT6797_WLAN_HIF
	tristate "MT6797 WLAN AHB sdioLike PIO HIF"
	depends on ARCH_MEDIATEK || COMPILE_TEST
	depends on OF
	depends on HAS_IOMEM
	help
	  Map the MT6797 WLAN AHB sdioLike command port and provide an explicit
	  owner-gated PIO/IRQ contract.  Probe never reads the HIF window; a future
	  WMT WLAN owner must turn the function on before claiming it.  AP-DMA,
	  EMI remap, firmware download and cfg80211 are separate steps.

endmenu
```

## drivers/thermal/mediatek/Kconfig
```kconfig
config MTK_THERMAL
	tristate "MediaTek thermal drivers"
	depends on THERMAL_OF
	help
	  This is the option for MediaTek thermal software solutions.
	  Please enable corresponding options to get temperature
	  information from thermal sensors or turn on throttle
	  mechaisms for thermal mitigation.

if MTK_THERMAL

config MTK_SOC_THERMAL
	tristate "AUXADC temperature sensor driver for MediaTek SoCs"
	depends on HAS_IOMEM
	help
	  Enable this option if you want to get SoC temperature
	  information for MediaTek platforms.
	  This driver configures thermal controllers to collect
	  temperature via AUXADC interface.

config MTK_MT6797_EEM
	tristate "MT6797 EEM hardware measurements with manual voltage ownership"
	depends on MTK_SOC_THERMAL && ARM_MT6797_CPUFREQ && NVMEM && OF
	help
	  Provide explicit INIT01/INIT02 calibration and MON measurements. The
	  CPU frequencies must first be lowered below 750 MHz. Calibration uses
	  temporary 1V rails and restores their previous voltages and modes.
	  Recommendations never change the manual OPP table or CPU voltages.

config MTK_MT6797_OTP
	tristate "MT6797 thermal PID using the manual CPUfreq OPPs"
	depends on MTK_SOC_THERMAL && CPU_FREQ && OF && ARM64
	help
	  Run the BSP hardware PID and apply its BIG frequency limit through
	  CPUfreq QoS, retaining the manual voltage curve. This does not enable
	  autonomous iDVFS voltage control. The default target is 150 degrees C.

config MTK_LVTS_THERMAL
        tristate "LVTS Thermal Driver for MediaTek SoCs"
        depends on HAS_IOMEM
        help
          Enable this option if you want to get SoC temperature
          information for supported MediaTek platforms.
          This driver configures LVTS (Low Voltage Thermal Sensor)
          thermal controllers to collect temperatures via ASIF
          (Analog Serial Interface).

config MTK_LVTS_THERMAL_DEBUGFS
       bool "LVTS thermal debugfs"
       depends on MTK_LVTS_THERMAL && DEBUG_FS
       help
         Enable this option to debug the internals of the device driver.

endif
```
